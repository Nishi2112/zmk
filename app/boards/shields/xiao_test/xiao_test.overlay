/ {
    chosen {
        zmk,kscan = &kscan0;
    };

    kscan0: kscan_0 {
        compatible = "zmk,kscan-gpio-direct";
        input-gpios
            = <&xiao_d 0 (GPIO_ACTIVE_LOW | GPIO_PULL_UP)>
            , <&xiao_d 1 (GPIO_ACTIVE_LOW | GPIO_PULL_UP)>
            ;
    };
};
